

void turn_stop() 

{ 

 

 

motor(in1,in2,0); 

 

 

motor(in1,in2,0); 

} 

void test() 

 

 

 

 

 

 

 

 

 

 

 

 

 

 

 

 

 

 

 

 

 

 

 

 

 

 

 

 

 

//

检测光电管探头。是黑线返回高电平（

1

）

，白

线返回低电平（

0

）

，这与实际电路相关

 

{ 

 

 

 

 

 

 

 

 

 

 

 

 

 

 

 

 

 

 

 

 

 

 

 

 

 

 

 

 

 

 

 

 

 

 

 

 

 

 

 

//0,1,2,6,4,7,8

是数字

IO

口，读取检测值

 

 

 

led1=digitalRead(0); 

 

 

led2=digitalRead(1); 

 

 

led3=digitalRead(2); 

 

 

led4=digitalRead(6); 

 

 

led5=digitalRead(4); 

 

 

led6=digitalRead(7); 

 

 

led7=digitalRead(8); 

} 

int 

deal() 

 

 

 

 

 

 

 

 

 

 

 

 

 

 

 

 

 

 

 

 

 

 

 

 

 

 

 

//

对每个探头赋值：从左往右

-6

，

-4

，

-2,0,2,4,6 

记

录检测到黑线的探头个数并将值相加

 

 

 

 

 

{ 

 

 

 

 

 

 

int a=0,b=0,c=0,d=0,e=0,f=0,g=0; 

 

 

 

 

 

 

int i=0,value=0; 

 

 

 

 

 

 

test(); 

 

 

 

 

 

 

if(led1==1) 

 

 

 

 

 

 

 

{ 

 

 

 

 

 

 

 

 

 

 

a=-6; 

 

 

 

 

 

 

 

 

 

i++; 

 

 

 

 

 

 

 

} 

 

 

 

 

 

 

 

if(led2==1) 

 

 

 

 

 

{ 

 

 

 

 

 

 

 

b=-4; 

 

 

 

 

 

 

 

i++; 

 

 

 

 

 

} 

 

 

 

 

 

 

if(led3==1) 

 

 

 

 

 

 

 

{ 

 

 

 

 

 

 

 

 

c=-2; 

 

 

 

 

 

 

 

 

i++; 

 

 

 

 

 

 

} 

 

 

 

 

 

 

if(led4==1) 

 

 

 

 

 

 

 

{ 

 

 

 

 

 

 

 

 

d=0; 

 

 

 

 

 

 

 

 

i++; 

 

 

 

 

 

 

} 

 

 

 

 

 

 

if(led5==1) 

 

 

 

 

 

{ 

 

 

 

 

 

 

 

e=2; 

 

 

 

 

 

 

 

i++; 

 

 

 

 

 

} 

 

 

 

 

 

 

if(led6==1) 

 

 

 

 

 

{ 

 

 

 

 

 

 

 

f=4; 

 

 

 

 

 

 

 

i++; 

 

 

 

 

 

} 

 

 

 

 

 

 

if(led7==1) 

 

 

 

 

 

 

 

{ 

 

 

 

 

 

 

 

 

g=6; 

 

 

 

 

 

 

 

 

i++; 

 

 

 

 

 

 

} 

 

 

 

 

 

 

sum=a+b+c+d+e+f+g; 

 

 

 

 

 

 

 

 

 

 

 

 

 

 

 

 

 

//

求平均值，较精确的确定黑线位置

 

 

 

 

 

 

 

if(i==0) value=8; 

 

 

 

 

 

 

 

 

 

 

 

 

 

 

 

 

 

 

//

分母不能为

0

，冲出跑道均没检测到的特殊情

况

,

让小车保持上一次的状态

 

 

 

 

 

 

 

else if(i<3) value=sum/i; 

 

 

 

 

 

 

 

 

 

 

//

一般的情况：

1

个或

2

个检测到黑线

 

 

 

 

 

 

 

else 

 

 

 

 

 

 

 

{ 

 

 

 

 

 

 

 

 

if(sum<0) value=-6; 

 

 

 

 

 

 

 

 

 

 

 

 

 

 

 

//

特殊情况：左急弯，右急弯，直道

 

 

 

 

 

 

 

 

 

else if(sum>0) value=6; 

 

 

 

 

 

 

 

 

else value=0; 

 

 

 

 

 

 

} 

 

 

 

 

 

 

return value; 

 

 

 

 

} 

void loop() 

 

{ 

 

 

 

static char a[5],j=0; 

 

 

 

 

 

 

 

 

 

 

 

 

 

 

 

 

 

//

数组记录上次值

 

 

 

if(j==5) j=0; 

 

 

if(deal()==8) 

 

 

{ 

 

 

 

 

if(j==0) a[j]=a[4]; 

 

 

 

 

else 

 

 

a[j]=a[j-1]; 

 

 

} 

 

 

switch(a[j]) 

 

 

 

 

 

 

 

 

 

 

 

 

 

 

 

 

 

 

 

 

 

 

 

 

 

 

 

//

对各种返回值的响应速度和转弯角度

 

 

 

{ 

 

 

 

 

case -6:turn_led1_0();break; 

 

 

 

 

case -5:turn_led1_1();break; 

 

 

 

 

case -4:turn_led2_0();break; 

 

 

 

 

case -3:turn_led2_1();break; 

 

 

 

 

case -2:turn_led3_0();break; 

 

 

 

 

case -1:turn_led3_1();break; 

 

 

 

 

case 

 

0:turn_led4_0();break; 

 

 

 

 

case 

 

1:turn_led4_1();break; 

 

 

 

 

case 

 

2:turn_led5_0();break; 

 

 

 

 

case 

 

3:turn_led5_1();break; 

 

 

 

 

case 

 

4:turn_led6_0();break; 

 

 

 

 

case 

 

5:turn_led6_1();break; 

 

 

 

 

case 

 

6:turn_led7_0();break; 

 

 

 

 

default:turn_led4_0();break; 

 

 

} 

 

 

j++; 

} 

/*

相比较于数字信号的话，这个处理程序应该比较好了。

PWM

值，角度，速度与实际情况

有较大联系，车的配置，摩擦，电压，车重量，电机转速，轮子大小等，所以各位下载后还

需细调。不过，这个程序就在于很好调，你只要改变上面的

PWM

值就可实现转弯与速度的

实际搭配

*/ 

